## Config.in
```kconfig
# Add project-specific packages for Buildroot here
#
# If these are non-proprietary, please consider contributing them back to
# Nerves or Buildroot.
source "$NERVES_DEFCONFIG_DIR/package/dump1090/Config.in"
```

## package/dump1090/Config.in
```kconfig
config BR2_PACKAGE_DUMP1090
        bool "dump1090"
	      depends on BR2_TOOLCHAIN_HAS_THREADS
	      select BR2_PACKAGE_LIBRTLSDR
        help
            Simple Mode S decoder for RTLSDR devices.

            https://github.com/mutability/dump1090

comment "dump1090 needs a toolchain w/ threads"
        depends on !BR2_TOOLCHAIN_HAS_THREADS
```
